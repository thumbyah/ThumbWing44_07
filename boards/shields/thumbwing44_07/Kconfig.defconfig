## boards/shields/thumbwing44_07/Kconfig.defconfig
```kconfig
if SHIELD_THUMBWING44_07_LEFT

config ZMK_KEYBOARD_NAME
    default "thumbwing44_07"

endif

if SHIELD_THUMBWING44_07_LEFT || SHIELD_THUMBWING44_07_RIGHT

config ZMK_SPLIT
    default y

endif
```

## boards/shields/thumbwing44_07/Kconfig.shield
```kconfig
config SHIELD_THUMBWING44_07_LEFT
    def_bool $(shields_list_contains,thumbwing44_07_left)
config SHIELD_THUMBWING44_07_RIGHT
    def_bool $(shields_list_contains,thumbwing44_07_right)
```
