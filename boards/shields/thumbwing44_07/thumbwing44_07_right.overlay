#include "thumbwing44_07.dtsi"

&default_transform {
    col-offset = <8>;
};

&kscan0 {
    row-gpios
        = <&akdk_d 9 (GPIO_ACTIVE_HIGH | GPIO_PULL_DOWN)>
        , <&akdk_d 5 (GPIO_ACTIVE_HIGH | GPIO_PULL_DOWN)>
        , <&akdk_d 4 (GPIO_ACTIVE_HIGH | GPIO_PULL_DOWN)>
        , <&akdk_d 3 (GPIO_ACTIVE_HIGH | GPIO_PULL_DOWN)>
        ;

    col-gpios
        = <&akdk_d 14 GPIO_ACTIVE_HIGH>
        , <&akdk_d 13 GPIO_ACTIVE_HIGH>
        , <&akdk_d 12 GPIO_ACTIVE_HIGH>
        , <&akdk_d 11 GPIO_ACTIVE_HIGH>
        , <&akdk_d 10 GPIO_ACTIVE_HIGH>
        , <&akdk_d 8  GPIO_ACTIVE_HIGH>
        , <&akdk_d 7  GPIO_ACTIVE_HIGH>
        , <&akdk_d 6  GPIO_ACTIVE_HIGH>
        ;
};
